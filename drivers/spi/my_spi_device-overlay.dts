/dts-v1/;

/plugin/;



/* 告訴核心我們要直接把設定附加到 spi0 節點上 */

&spi0 {

    status = "okay";

    #address-cells = <1>;

    #size-cells = <0>;



    /* @0 對應下方的 reg = <0>; 符合設備樹標準規範 */

    ssd1306: ssd1306@0 {

        compatible = "peng,spi-dummy-driver";

        reg = <0>;                      /* CE0 (SPI 片選 0) */

        spi-max-frequency = <1000000>;  /* 1 MHz */



        /* 宣告 gpiod 使用的引腳 (對應 Pi 5 的 RP1 GPIO 晶片) */

        dc-gpios = <&gpio 25 0>;        /* GPIO 25, 0 代表高電位有效 */

        reset-gpios = <&gpio 24 0>;     /* GPIO 24, 0 代表高電位有效 */

        status = "okay";

    };

};